## CMakeLists.txt
```
#
# Copyright (c) 2023 Nordic Semiconductor ASA
#
# SPDX-License-Identifier: LicenseRef-Nordic-5-Clause
#

cmake_minimum_required(VERSION 3.20.0)

find_package(Zephyr HINTS $ENV{ZEPHYR_BASE})

project(matter-bridge)

# Enable GNU STD support.
include(${ZEPHYR_CONNECTEDHOMEIP_MODULE_DIR}/config/nrfconnect/app/enable-gnu-std.cmake)

# NORDIC SDK APP START

# Include all source files that are located in the Matter common directory.
include(${ZEPHYR_NRF_MODULE_DIR}/samples/matter/common/cmake/source_common.cmake)

# Include Data Model utils
include(${ZEPHYR_NRF_MODULE_DIR}/samples/matter/common/cmake/data_model.cmake)

include(${ZEPHYR_NRF_MODULE_DIR}/samples/matter/common/cmake/zap_helpers.cmake)
ncs_get_zap_parent_dir(ZAP_PARENT_DIR)

target_include_directories(app PRIVATE
  src
  src/bridged_device_types
  ${ZAP_PARENT_DIR}
  src/core/util
  src/core
)

target_sources(app PRIVATE
  src/app_task.cpp
  src/main.cpp
  src/bridge_shell.cpp
  src/zcl_callbacks.cpp
  src/core/bridge_manager.cpp
  src/core/matter_bridged_device.cpp
  src/core/bridge_storage_manager.cpp
  src/core/bridged_device_data_provider.cpp
  ${ZEPHYR_NRF_MODULE_DIR}/samples/matter/common/src/binding/binding_handler.cpp
)

if(CONFIG_BRIDGED_DEVICE_BT)
  target_sources(app PRIVATE
    src/ble/ble_connectivity_manager.cpp
    src/ble/ble_bridged_device_factory.cpp
  )
  target_include_directories(app PRIVATE
    src/ble
    src/ble/data_providers
  )

  target_sources(app PRIVATE
    src/ble/data_providers/bt_home_atc_mith_data_provider.cpp
  )

if(CONFIG_BRIDGE_ONOFF_LIGHT_BRIDGED_DEVICE AND (CONFIG_BRIDGE_GENERIC_SWITCH_BRIDGED_DEVICE OR CONFIG_BRIDGE_ONOFF_LIGHT_SWITCH_BRIDGED_DEVICE))
  target_sources(app PRIVATE
    src/bridged_device_types/onoff_light.cpp
    src/ble/data_providers/ble_lbs_data_provider.cpp
  )

if(CONFIG_BRIDGE_GENERIC_SWITCH_BRIDGED_DEVICE)
  target_sources(app PRIVATE src/bridged_device_types/generic_switch.cpp)
endif()

if(CONFIG_BRIDGE_ONOFF_LIGHT_SWITCH_BRIDGED_DEVICE)
  target_sources(app PRIVATE
    src/bridged_device_types/onoff_light_switch.cpp
  )
endif()

endif() # CONFIG_BRIDGE_ONOFF_LIGHT_BRIDGED_DEVICE AND (CONFIG_BRIDGE_GENERIC_SWITCH_BRIDGED_DEVICE OR CONFIG_BRIDGE_ONOFF_LIGHT_SWITCH_BRIDGED_DEVICE)

if(CONFIG_BRIDGE_HUMIDITY_SENSOR_BRIDGED_DEVICE)
  target_sources(app PRIVATE
    src/bridged_device_types/humidity_sensor.cpp
  )
endif() # CONFIG_BRIDGE_HUMIDITY_SENSOR_BRIDGED_DEVICE

if(CONFIG_BRIDGE_TEMPERATURE_SENSOR_BRIDGED_DEVICE)
  target_sources(app PRIVATE
    src/bridged_device_types/temperature_sensor.cpp
  )
endif() # CONFIG_BRIDGE_TEMPERATURE_SENSOR_BRIDGED_DEVICE

# Assume it makes no sense to support BLE environmental sensor without all Matter counterparts
if(CONFIG_BRIDGE_TEMPERATURE_SENSOR_BRIDGED_DEVICE AND CONFIG_BRIDGE_HUMIDITY_SENSOR_BRIDGED_DEVICE)
  target_sources(app PRIVATE
    src/ble/data_providers/ble_environmental_data_provider.cpp
)
endif() # CONFIG_BRIDGE_TEMPERATURE_SENSOR_BRIDGED_DEVICE AND CONFIG_BRIDGE_HUMIDITY_SENSOR_BRIDGED_DEVICE

else()
  target_sources(app PRIVATE
    src/simulated_providers/simulated_bridged_device_factory.cpp
  )
  target_include_directories(app PRIVATE src/simulated_providers)

if(CONFIG_BRIDGE_ONOFF_LIGHT_BRIDGED_DEVICE AND (CONFIG_BRIDGE_GENERIC_SWITCH_BRIDGED_DEVICE OR CONFIG_BRIDGE_ONOFF_LIGHT_SWITCH_BRIDGED_DEVICE))
  target_sources(app PRIVATE
    src/bridged_device_types/onoff_light.cpp
    src/simulated_providers/simulated_onoff_light_data_provider.cpp
  )

if(CONFIG_BRIDGE_GENERIC_SWITCH_BRIDGED_DEVICE)
  target_sources(app PRIVATE
    src/bridged_device_types/generic_switch.cpp
    src/simulated_providers/simulated_generic_switch_data_provider.cpp
  )
endif()

if(CONFIG_BRIDGE_ONOFF_LIGHT_SWITCH_BRIDGED_DEVICE)
  target_sources(app PRIVATE
    src/bridged_device_types/onoff_light_switch.cpp
    src/simulated_providers/simulated_onoff_light_switch_data_provider.cpp
  )
endif()

endif() # CONFIG_BRIDGE_ONOFF_LIGHT_BRIDGED_DEVICE AND (CONFIG_BRIDGE_GENERIC_SWITCH_BRIDGED_DEVICE OR CONFIG_BRIDGE_ONOFF_LIGHT_SWITCH_BRIDGED_DEVICE))

if(CONFIG_BRIDGE_TEMPERATURE_SENSOR_BRIDGED_DEVICE)
  target_sources(app PRIVATE
    src/bridged_device_types/temperature_sensor.cpp
    src/simulated_providers/simulated_temperature_sensor_data_provider.cpp
  )
endif() # CONFIG_BRIDGE_TEMPERATURE_SENSOR_BRIDGED_DEVICE

if(CONFIG_BRIDGE_HUMIDITY_SENSOR_BRIDGED_DEVICE)
  target_sources(app PRIVATE
    src/bridged_device_types/humidity_sensor.cpp
    src/simulated_providers/simulated_humidity_sensor_data_provider.cpp
  )
endif() # CONFIG_BRIDGE_HUMIDITY_SENSOR_BRIDGED_DEVICE

endif() # CONFIG_BRIDGED_DEVICE_BT

ncs_configure_data_model()
# NORDIC SDK APP END
```

## Kconfig
```
#
# Copyright (c) 2023 Nordic Semiconductor
#
# SPDX-License-Identifier: LicenseRef-Nordic-5-Clause
#
mainmenu "Matter nRF Connect Bridge Example Application"

config BRIDGE_ONOFF_LIGHT_BRIDGED_DEVICE
	bool "Support for OnOff Light bridged device"
	default y

config BRIDGE_TEMPERATURE_SENSOR_BRIDGED_DEVICE
	bool "Support for Temperature Sensor bridged device"
	default y

config BRIDGE_HUMIDITY_SENSOR_BRIDGED_DEVICE
	bool "Support for Humidity Sensor bridged device"
	default y

choice BRIDGE_SWITCH_BRIDGED_DEVICE
	prompt "Bridged device switch implementation"
	default BRIDGE_GENERIC_SWITCH_BRIDGED_DEVICE

config BRIDGE_GENERIC_SWITCH_BRIDGED_DEVICE
	bool "Support for Generic Switch bridged device"

config BRIDGE_ONOFF_LIGHT_SWITCH_BRIDGED_DEVICE
	bool "Support for OnOff Light Switch bridged device"

endchoice

choice BRIDGED_DEVICE_IMPLEMENTATION
	prompt "Bridged Device implementation"
	default BRIDGED_DEVICE_SIMULATED

config BRIDGED_DEVICE_SIMULATED
	bool "Simulated Bridged Device"
	help
	  Enables using simulated bridged devices that do not perform
	  real operations, but emulate exemplary data to imitate the real
	  device behavior.

config BRIDGED_DEVICE_BT
	bool "Bluetooth LE Bridged Device"
	help
	  Enables using real bridged devices that communicate with the Matter bridge device
	  over Bluetooth LE.

endchoice

if BRIDGED_DEVICE_SIMULATED

choice BRIDGED_DEVICE_SIMULATED_ONOFF_IMPLEMENTATION
	prompt "Simulated bridged onoff device implementation"
	default BRIDGED_DEVICE_SIMULATED_ONOFF_SHELL

config BRIDGED_DEVICE_SIMULATED_ONOFF_AUTOMATIC
	bool "Automatically simulated bridged onoff device"
	help
	  Enables using simulated bridged onoff device that
	  automatically changes its state periodically.

config BRIDGED_DEVICE_SIMULATED_ONOFF_SHELL
	bool "Shell controlled simulated bridged onoff device"
	help
	  Enables using simulated bridged onoff device that is
	  controlled by shell commands.

endchoice

endif

if BRIDGED_DEVICE_BT

config BT_CENTRAL
	default y

config BT_SCAN
	default y

# Configure how many Bluetooth LE devices the Matter bridge can support (the final number is given value - 1, as 1 connection is used for the Matter Bluetooth LE service).
config BT_MAX_CONN
	default 10

config BT_SCAN_FILTER_ENABLE
	default y

# Configure how many Bluetooth LE service UUIDs the Matter bridge can scan.
config BT_SCAN_UUID_CNT
	default 3

config BT_SCAN_ADDRESS_CNT
	default 1

config BT_GATT_CLIENT
	default y

config BT_GATT_DM
	default y

config BT_EXT_ADV
	default y

config BT_SMP
	default y

if BT_SMP

config BT_SETTINGS
	default y

# Configure how many Bluetooth LE devices will be paired with Matter bridge. Assuming it will be only bridged devices, it should be set to BT_MAX_CONN - 1.
config BT_MAX_PAIRED
	default 9

# Use two Bluetooth LE identities. The first one is used by the peripheral for Matter service advertising purposes, and the other is used by the Matter bridge central.
config BT_ID_MAX
	default 2

config BT_EXT_ADV_LEGACY_SUPPORT
	default y

endif

config BRIDGE_BLE_DEVICE_POLLING_INTERVAL
	int "BLE humidity measurement readout polling interval in ms"
	default 3000

endif

if BRIDGE_TEMPERATURE_SENSOR_BRIDGED_DEVICE

config BRIDGE_TEMPERATURE_SENSOR_MIN_MEASURED_VALUE
	int "Default minimum measured value allowed by the bridged temperature sensor device"
	default -20

config BRIDGE_TEMPERATURE_SENSOR_MAX_MEASURED_VALUE
	int "Default maximum measured value allowed by the bridged temperature sensor device"
	default 60

endif

if BRIDGE_HUMIDITY_SENSOR_BRIDGED_DEVICE

config BRIDGE_HUMIDITY_SENSOR_MIN_MEASURED_VALUE
	int "Default minimum measured value allowed by the bridged humidity sensor device"
	default 0

config BRIDGE_HUMIDITY_SENSOR_MAX_MEASURED_VALUE
	int "Default maximum measured value allowed by the bridged humidity sensor device"
	default 100

endif

# Enable Read Client functionality for all build configurations.
config CHIP_ENABLE_READ_CLIENT
	default y

config NCS_SAMPLE_MATTER_PERSISTENT_STORAGE
	default y

config BRIDGE_SMART_PLUG_SUPPORT
	bool "Additional endpoint implementing Matter smart plug functionality"

# Sample configuration used for Thread networking
if OPENTHREAD

choice OPENTHREAD_NORDIC_LIBRARY_CONFIGURATION
	default OPENTHREAD_NORDIC_LIBRARY_FTD
endchoice

choice OPENTHREAD_DEVICE_TYPE
	default OPENTHREAD_FTD
endchoice

endif # OPENTHREAD

config CHIP_WIFI
	default y if BOARD_NRF7002DK_NRF5340_CPUAPP || SHIELD_NRF7002EK || SHIELD_NRF7002EB2
	select DEPRECATED if SOC_SERIES_NRF53X

# Dummy Kconfig just to select experimental for some of the configurations.
config BRIDGE_EXPERIMENTAL
	bool
	default y if OPENTHREAD || BRIDGE_SMART_PLUG_SUPPORT
	select EXPERIMENTAL

source "$(ZEPHYR_CONNECTEDHOMEIP_MODULE_DIR)/config/nrfconnect/chip-module/Kconfig.features"
source "$(ZEPHYR_CONNECTEDHOMEIP_MODULE_DIR)/config/nrfconnect/chip-module/Kconfig.defaults"
source "$(ZEPHYR_NRF_MODULE_DIR)/applications/matter_bridge/src/core/Kconfig"
source "$(ZEPHYR_NRF_MODULE_DIR)/samples/matter/common/src/Kconfig"
source "Kconfig.zephyr"
```

## prj.conf
```kconfig
#
# Copyright (c) 2023 Nordic Semiconductor ASA
#
# SPDX-License-Identifier: LicenseRef-Nordic-5-Clause
#

# This sample uses Kconfig.defaults to set options common for all
# samples. This file should contain only options specific for this sample
# or overrides of default values.

# Enable CHIP
CONFIG_CHIP=y
CONFIG_CHIP_PROJECT_CONFIG="src/chip_project_config.h"
CONFIG_CHIP_DEVICE_PRODUCT_NAME="Matter Bridge"

# Configure ZAP file name
CONFIG_NCS_SAMPLE_MATTER_ZAP_FILE_PATH="${APPLICATION_CONFIG_DIR}/src/default_zap/bridge.zap"

# 32770 == 0x8002 (example bridge)
CONFIG_CHIP_DEVICE_PRODUCT_ID=32770
CONFIG_STD_CPP17=y

# Enable Matter pairing automatically on application start.
CONFIG_CHIP_ENABLE_PAIRING_AUTOSTART=y

# Enable Matter extended announcement and increase duration to 1 hour.
CONFIG_CHIP_BLE_EXT_ADVERTISING=y
CONFIG_CHIP_BLE_ADVERTISING_DURATION=60

# Add support for LEDs and buttons on Nordic development kits
CONFIG_DK_LIBRARY=y

# Bluetooth Low Energy configuration
CONFIG_BT_DEVICE_NAME="MatterBridge"

# Extend scan duration for BTHome devices
CONFIG_BRIDGE_BT_SCAN_TIMEOUT_MS=15000

# Other settings
CONFIG_THREAD_NAME=y
CONFIG_MPU_STACK_GUARD=y
CONFIG_RESET_ON_FATAL_ERROR=n
CONFIG_CHIP_LIB_SHELL=y
CONFIG_NCS_SAMPLE_MATTER_TEST_SHELL=y

# Reduce assert verbosity to save flash space.
CONFIG_ASSERT_NO_FILE_INFO=y

# Disable NFC onboarding
CONFIG_CHIP_NFC_ONBOARDING_PAYLOAD=n

# Reduce application size
CONFIG_USE_SEGGER_RTT=n

# Enable Factory Data feature
CONFIG_CHIP_FACTORY_DATA=y
CONFIG_CHIP_FACTORY_DATA_BUILD=y

# Increase heap size to accommodate the memory required for additional bridged devices.
CONFIG_CHIP_MALLOC_SYS_HEAP_SIZE=16384
```

## src/app_task.cpp
```c
/*
 * Copyright (c) 2023 Nordic Semiconductor ASA
 *
 * SPDX-License-Identifier: LicenseRef-Nordic-5-Clause
 */

#include "app_task.h"

#ifdef CONFIG_BRIDGED_DEVICE_BT
#include "ble/data_providers/bt_home_atc_mith_data_provider.h"
#endif /* CONFIG_BRIDGED_DEVICE_BT */

#ifdef CONFIG_BRIDGED_DEVICE_BT
#include "ble_bridged_device_factory.h"
#else
#include "simulated_bridged_device_factory.h"
#endif /* CONFIG_BRIDGED_DEVICE_BT */

#include "app/matter_init.h"
#include "app/task_executor.h"
#include "board/board.h"
#include "bridge_manager.h"
#include "bridge_storage_manager.h"
#include "clusters/identify.h"

#ifdef CONFIG_BRIDGED_DEVICE_BT
#include "ble_connectivity_manager.h"
#endif

#include <app-common/zap-generated/attributes/Accessors.h>
#include <app-common/zap-generated/ids/Attributes.h>
#include <app-common/zap-generated/ids/Clusters.h>
#include <setup_payload/OnboardingCodesUtil.h>

#ifdef CONFIG_BRIDGED_DEVICE_BT
#include <bluetooth/services/lbs.h>
#endif /* CONFIG_BRIDGED_DEVICE_BT */
#include <zephyr/logging/log.h>

#ifdef CONFIG_BRIDGE_SMART_PLUG_SUPPORT
#define APPLICATION_BUTTON_MASK DK_BTN2_MSK
#endif /* CONFIG_BRIDGE_SMART_PLUG_SUPPORT */

LOG_MODULE_DECLARE(app, CONFIG_CHIP_APP_LOG_LEVEL);

using namespace ::chip;
using namespace ::chip::app;
using namespace ::chip::DeviceLayer;

namespace
{

constexpr EndpointId kBridgeEndpointId = 1;

#ifndef CONFIG_BRIDGE_SMART_PLUG_SUPPORT
/* Trigger effect is enabled for the bridge device */
Nrf::Matter::IdentifyCluster sIdentifyCluster(kBridgeEndpointId, true);
#else
Nrf::Matter::IdentifyCluster sIdentifyCluster(kBridgeEndpointId);
#endif

#ifdef CONFIG_BRIDGED_DEVICE_BT
const bt_uuid *sUuidLbs = BT_UUID_LBS;
const bt_uuid *sUuidEs = BT_UUID_ESS;
const bt_uuid *sUuidBtHomeAtcMiTh = BT_UUID_BT_HOME_ATC_MITHERMOMETER;
const bt_uuid *sUuidServices[] = { sUuidLbs, sUuidEs, sUuidBtHomeAtcMiTh };
constexpr uint8_t kUuidServicesNumber = ARRAY_SIZE(sUuidServices);
/**
 * @brief Blink rates for indication the BLE Connectivity Manager state.
 *
 */
constexpr uint32_t kPairingBlinkRate{ 100 };
constexpr uint32_t kScanningBlinkRate_ms{ 300 };
constexpr uint32_t kLostBlinkRate_ms{ 1000 };
#ifndef CONFIG_BRIDGE_SMART_PLUG_SUPPORT
void BLEStateChangeCallback(Nrf::BLEConnectivityManager::State state)
{
	switch (state) {
	case Nrf::BLEConnectivityManager::State::Connected:
		Nrf::PostTask([] { Nrf::GetBoard().GetLED(Nrf::DeviceLeds::LED2).Set(true); });
		break;
	case Nrf::BLEConnectivityManager::State::Scanning:
		Nrf::PostTask([] {
			Nrf::GetBoard()
				.GetLED(Nrf::DeviceLeds::LED2)
				.Blink(kScanningBlinkRate_ms, kScanningBlinkRate_ms);
		});
		break;
	case Nrf::BLEConnectivityManager::State::LostDevice:
		Nrf::PostTask([] {
			Nrf::GetBoard().GetLED(Nrf::DeviceLeds::LED2).Blink(kLostBlinkRate_ms, kLostBlinkRate_ms);
		});
		break;
	case Nrf::BLEConnectivityManager::State::Pairing:
		Nrf::PostTask([] {
			Nrf::GetBoard().GetLED(Nrf::DeviceLeds::LED2).Blink(kPairingBlinkRate, kPairingBlinkRate);
		});
		break;
	default:
		Nrf::PostTask([] { Nrf::GetBoard().GetLED(Nrf::DeviceLeds::LED2).Set(false); });
	}
}
#endif /* CONFIG_BRIDGE_SMART_PLUG_SUPPORT */

#endif /* CONFIG_BRIDGED_DEVICE_BT */

#ifndef CONFIG_CHIP_FACTORY_RESET_ERASE_SETTINGS
void AppFactoryResetHandler(const ChipDeviceEvent *event, intptr_t /* unused */)
{
	switch (event->Type) {
	case DeviceEventType::kFactoryReset:
		Nrf::BridgeStorageManager::Instance().FactoryReset();
		break;
	default:
		break;
	}
}
#endif

} /* namespace */

CHIP_ERROR AppTask::RestoreBridgedDevices()
{
	uint8_t count;
	uint8_t indexes[Nrf::BridgeManager::kMaxBridgedDevices] = { 0 };
	size_t indexesCount = 0;

	if (!Nrf::BridgeStorageManager::Instance().LoadBridgedDevicesCount(count)) {
		LOG_INF("No bridged devices to load from the storage.");
		return CHIP_NO_ERROR;
	}

	if (!Nrf::BridgeStorageManager::Instance().LoadBridgedDevicesIndexes(
		    indexes, Nrf::BridgeManager::kMaxBridgedDevices, indexesCount)) {
		return CHIP_NO_ERROR;
	}

	/* Load all devices based on the read count number. */
	for (size_t i = 0; i < indexesCount; i++) {
		Nrf::BridgeStorageManager::BridgedDevice device;
#ifdef CONFIG_BRIDGED_DEVICE_BT
		bt_addr_le_t btAddr;
		device.mUserData = reinterpret_cast<uint8_t *>(&btAddr);
		device.mUserDataSize = sizeof(btAddr);
#endif

		if (!Nrf::BridgeStorageManager::Instance().LoadBridgedDevice(device, indexes[i])) {
			return CHIP_ERROR_NOT_FOUND;
		}

		LOG_INF("Loaded bridged device on endpoint id %d from the storage", device.mEndpointId);

#ifdef CONFIG_BRIDGED_DEVICE_BT
		BleBridgedDeviceFactory::CreateDevice(device.mDeviceType, btAddr, device.mUniqueID, device.mNodeLabel,
						      indexes[i], device.mEndpointId);
#else
		SimulatedBridgedDeviceFactory::CreateDevice(device.mDeviceType, device.mUniqueID, device.mNodeLabel,
							    chip::Optional<uint8_t>(indexes[i]),
							    chip::Optional<uint16_t>(device.mEndpointId));
#endif
	}
	return CHIP_NO_ERROR;
}
#ifdef CONFIG_BRIDGE_SMART_PLUG_SUPPORT
void AppTask::SmartplugOnOffEventHandler()
{
	SystemLayer().ScheduleLambda([] {
		bool newState = !Nrf::GetBoard().GetLED(Nrf::DeviceLeds::LED2).GetState();
		Protocols::InteractionModel::Status status =
			Clusters::OnOff::Attributes::OnOff::Set(kSmartplugEndpointId, newState);
		if (status != Protocols::InteractionModel::Status::Success) {
			LOG_ERR("Updating on/off cluster failed: %x", to_underlying(status));
		}
	});
}

void AppTask::ButtonEventHandler(Nrf::ButtonState state, Nrf::ButtonMask hasChanged)
{
	if ((APPLICATION_BUTTON_MASK & hasChanged) & state) {
		Nrf::PostTask([] { SmartplugOnOffEventHandler(); });
	}
}
#endif /* CONFIG_BRIDGE_SMART_PLUG_SUPPORT */

CHIP_ERROR AppTask::Init()
{
	/* Initialize Matter stack */
	ReturnErrorOnFailure(Nrf::Matter::PrepareServer(Nrf::Matter::InitData{ .mPostServerInitClbk = [] {
#ifdef CONFIG_BRIDGED_DEVICE_BT
#ifndef CONFIG_BRIDGE_SMART_PLUG_SUPPORT
		Nrf::BLEConnectivityManager::Instance().RegisterStateCallback(BLEStateChangeCallback);
#endif /* CONFIG_BRIDGE_SMART_PLUG_SUPPORT */
		/* Initialize BLE Connectivity Manager before the Bridge Manager, as it must be ready to recover
		 * devices loaded from persistent storage during the bridge init. */
		CHIP_ERROR bleInitError =
			Nrf::BLEConnectivityManager::Instance().Init(sUuidServices, kUuidServicesNumber);
		if (bleInitError != CHIP_NO_ERROR) {
			LOG_ERR("BLEConnectivityManager initialization failed");
			return bleInitError;
		}
#endif

		/* Initialize bridge manager */
		CHIP_ERROR bridgeMgrInitError = Nrf::BridgeManager::Instance().Init(RestoreBridgedDevices);
		if (bridgeMgrInitError != CHIP_NO_ERROR) {
			LOG_ERR("BridgeManager initialization failed");
			return bridgeMgrInitError;
		}
		return CHIP_NO_ERROR;
	} }));
#ifdef CONFIG_BRIDGE_SMART_PLUG_SUPPORT
	/* onoff plug part add buttonEventHandler*/
	if (!Nrf::GetBoard().Init(ButtonEventHandler)) {
		LOG_ERR("User interface initialization failed.");
		return CHIP_ERROR_INCORRECT_STATE;
	}
#else
	if (!Nrf::GetBoard().Init()) {
		LOG_ERR("User interface initialization failed.");
		return CHIP_ERROR_INCORRECT_STATE;
	}
#endif
	/* Register Matter event handler that controls the connectivity status LED based on the captured Matter
	 * network state. */
	ReturnErrorOnFailure(Nrf::Matter::RegisterEventHandler(Nrf::Board::DefaultMatterEventHandler, 0));

#ifndef CONFIG_CHIP_FACTORY_RESET_ERASE_SETTINGS
	/* Register factory reset event handler.
	 * With this configuration we have to manually clean up the storage,
	 * as whole settings partition won't be erased.
	 * */
	ReturnErrorOnFailure(Nrf::Matter::RegisterEventHandler(AppFactoryResetHandler, 0));
#endif

	ReturnErrorOnFailure(sIdentifyCluster.Init());

	return Nrf::Matter::StartServer();
}

CHIP_ERROR AppTask::StartApp()
{
	ReturnErrorOnFailure(Init());

	while (true) {
		Nrf::DispatchNextTask();
	}

	return CHIP_NO_ERROR;
}
```
