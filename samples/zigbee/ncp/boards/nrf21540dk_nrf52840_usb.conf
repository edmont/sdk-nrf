## samples/zigbee/ncp/boards/nrf21540dk_nrf52840_usb.conf
```kconfig
#
# Copyright (c) 2021 Nordic Semiconductor ASA
#
# SPDX-License-Identifier: LicenseRef-Nordic-5-Clause
#

# Enable MCUBoot
CONFIG_BOOTLOADER_MCUBOOT=y
```
